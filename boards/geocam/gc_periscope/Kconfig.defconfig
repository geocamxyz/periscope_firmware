## boards/geocam/gc_periscope/Kconfig.defconfig
```kconfig
if BOARD_GC_PERISCOPE

config BOARD
    default "gc_periscope"

endif # BOARD_GC_PERISCOPE
```

## boards/geocam/gc_periscope/Kconfig.gc_periscope
```kconfig
config BOARD_GC_PERISCOPE
    bool "geocam_periscope"
    select SOC_RP2040
    select RP2_FLASH_W25Q080
```

## boards/geocam/gc_periscope/board.yml
```yaml
board:
  name: gc_periscope
  vendor: geocam
  full_name: GeoCam Periscope
  socs:
    - name: rp2040
```

## boards/geocam/gc_periscope/gc_periscope_defconfig
```kconfig
CONFIG_BOARD_GC_PERISCOPE=y
CONFIG_CONSOLE=y
CONFIG_SERIAL=y
CONFIG_GPIO=y
CONFIG_CLOCK_CONTROL=y
CONFIG_BUILD_OUTPUT_UF2=y
CONFIG_USB_DEVICE_STACK=y
```
